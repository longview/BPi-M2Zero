/dts-v1/;
/plugin/;

/* This overlay works on the M2Z, it adds a PPS interface to PA7.
The armbian default one didn't work for me.*/

/ {
        compatible = "allwinner,sun8i-h3";

        fragment@0 {
                target = <&pio>;
                __overlay__ {
                        pps_pins: pps_pins {
                                pins = "PA7";
                                function = "gpio_in";
                        };
                };
        };

        fragment@1 {
                target-path = "/";
                __overlay__ {
                        pps@0 {
                                compatible = "pps-gpio";
                                pinctrl-names = "default";
                                pinctrl-0 = <&pps_pins>;
                                gpios = <&pio 0 7 0>; /* PA7 */
                                status = "okay";
                        };
                };
        };
};
